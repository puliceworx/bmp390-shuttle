## drivers/sensor/Kconfig
```kconfig
# Copyright (c) 2021 Nordic Semiconductor ASA
# SPDX-License-Identifier: Apache-2.0

comment "Device Drivers"

if SENSOR
  rsource "bmp390/Kconfig"
endif # SENSOR
```

## drivers/sensor/bmp390/Kconfig
```kconfig
# Copyright (c) 2020 Facebook, Inc. and its affiliates
# SPDX-License-Identifier: Apache-2.0

menuconfig BMP390
	bool "Bosch BMP390 pressure sensor"
	default n
 	select I2C
	help
	  Enable driver for the Bosch BMP390 pressure sensor

if BMP390

choice BMP390_TRIGGER_MODE
	prompt "Trigger mode"
	default BMP390_TRIGGER_GLOBAL_THREAD
	help
	  Specify the type of triggering to be used by the driver.

config BMP390_TRIGGER_NONE
	bool "No trigger"

config BMP390_TRIGGER_GLOBAL_THREAD
	bool "Use global thread"
	select BMP390_TRIGGER

config BMP390_TRIGGER_OWN_THREAD
	bool "Use own thread"
	select BMP390_TRIGGER

config BMP390_TRIGGER_DIRECT
	bool "Use IRQ handler"
	select BMP390_TRIGGER
endchoice

#config BMP390_TRIGGER
#	bool

config BMP390_THREAD_PRIORITY
	int "Own thread priority"
	depends on BMP390_TRIGGER_OWN_THREAD
	default 10
	help
	  Priority of the thread used by the driver to handle interrupts.

config BMP390_THREAD_STACK_SIZE
	int "Own thread stack size"
	depends on BMP390_TRIGGER_OWN_THREAD
	default 1024
	help
	  Stack size of thread used by the driver to handle interrupts.

config BMP390_ODR_RUNTIME
	bool "Change ODR at runtime."
	default y

config BMP390_OSR_RUNTIME
	bool "Change OSR at runtime."
	default y

module = BMP390
module-str = BMP390
source "${ZEPHYR_BASE}/subsys/logging/Kconfig.template.log_config"

endif # BMP390
```
